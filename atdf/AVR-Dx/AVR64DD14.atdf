# AVR64DD14 device description
Architecture: AVR8X; Family: AVR
Programming and debug interfaces: UPDI
Registers are 8-bit, read-write, reset 0x0 unless marked. A register's access mark holds for its fields unless they carry their own. Offsets are from the block's base; lines under a group give offsets from that group; [hi:lo] are bit positions; {n}, {i} and the like mark numbered series; 'fields as' and 'values as' point back to an identical list; <NAME> marks a mode.

## Ordering variants
AVR64DD14: SOIC14, pinout SOIC14MVIO, up to 32 MHz, -40 to 125 C, 1.8 to 5.5 V

## Memory
data space: start 0x0000 size 0x10000, little endian
  0x00 IO size 0x103F io, rw
  0x1040 LOCKBITS size 0x04 lockbits, rw, page 0x1
  0x1050 FUSES size 0x10 fuses, rw, page 0x1
  0x1080 USER_SIGNATURES size 0x20 user_signatures, rw, page 0x20
  0x1100 SIGNATURES size 0x03 signatures, ro, page 0x80
  0x1103 PROD_SIGNATURES size 0x7D signatures, ro, page 0x80
  0x1400 EEPROM size 0x100 eeprom, rw, page 0x1
  0x6000 INTERNAL_SRAM size 0x2000 ram, rw
  0x8000 MAPPED_PROGMEM size 0x8000 other, rw, page 0x200
prog space: start 0x0000 size 0x10000, little endian
  0x00 PROGMEM size 0x10000 flash, rw, executable, page 0x200

## Peripheral instances (address, pins/pin function, parameters)
AC0 at 0x0680 (AC)
  pins: N2 PD7; N3 PC2; P3 PD6; P4 PC3
ADC0 at 0x0600 (ADC)
  pins: AIN4 PD4/AIN0; AIN5 PD5/AIN0; AIN6 PD6/AIN0; AIN7 PD7/AIN0; AIN29 PC1/AIN0; AIN30 PC2/AIN0; AIN31 PC3/AIN0
BOD at 0x00A0
CCL at 0x01C0
  pins: LUT0_IN0 PA0 or PA0/CCL_ALT1; LUT0_IN1 PA1 or PA1/CCL_ALT1; LUT1_IN1 PC1 or PC1/CCL_ALT1; LUT1_IN2 PC2 or PC2/CCL_ALT1; LUT1_OUT0 PC3; LUT2_OUT0 PD6/CCL_ALT1
  pin routing set by: PORTMUX.CCLROUTEA.LUT0, PORTMUX.CCLROUTEA.LUT1, PORTMUX.CCLROUTEA.LUT2
CLKCTRL at 0x0060
  pins: EXTCLK PA0; XTALHF1 PA0; XTALHF2 PA1; XTAL32K1 PA0/CLKCTRL_ALT1; XTAL32K2 PA1/CLKCTRL_ALT1
CPU at 0x0030
  parameters: CORE_VERSION=V4S
CPUINT at 0x0110
CRCSCAN at 0x0120
DAC0 at 0x06A0 (DAC)
  pins: OUT0 PD6
EVSYS at 0x0200
  pins: EVOUT2 PC2; EVOUT3 PD7/EVSYS_ALT1; EVOUT5 PF7/EVSYS_ALT1
  pin routing set by: PORTMUX.EVSYSROUTEA.EVOUTC, PORTMUX.EVSYSROUTEA.EVOUTD, PORTMUX.EVSYSROUTEA.EVOUTF
FUSE at 0x1050
GPR at 0x001C
LOCK at 0x1040
MVIO at 0x00C0
NVMCTRL at 0x1000
PORTA at 0x0400 (PORT)
  pins: PIN0 PA0/IOPORT; PIN1 PA1/IOPORT
PORTC at 0x0440 (PORT)
  pins: PIN1 PC1/IOPORT; PIN2 PC2/IOPORT; PIN3 PC3/IOPORT
PORTD at 0x0460 (PORT)
  pins: PIN4 PD4/IOPORT; PIN5 PD5/IOPORT; PIN6 PD6/IOPORT; PIN7 PD7/IOPORT
PORTF at 0x04A0 (PORT)
  pins: PIN6 PF6/IOPORT; PIN7 PF7/IOPORT
PORTMUX at 0x05E0
RSTCTRL at 0x0040
  pins: RESET PF6/OTHER
RTC at 0x0140
SIGROW at 0x1100
SLPCTRL at 0x0050
SPI0 at 0x0940 (SPI)
  pins: MISO PA1/SPI0_ALT3 or PD5/SPI0_ALT4 or PC1/SPI0_ALT5 or PC2/SPI0_ALT6; MOSI PA0/SPI0_ALT3 or PD4/SPI0_ALT4 or PC1/SPI0_ALT6; SS PC1/SPI0_ALT3 or PD7/SPI0_ALT4 or PC3/SPI0_ALT5 or PF7/SPI0_ALT6; SCK PD6/SPI0_ALT4 or PC2/SPI0_ALT5 or PC3/SPI0_ALT6
  pin routing set by: PORTMUX.SPIROUTEA.SPI0
SYSCFG at 0x0F00
TCA0 at 0x0A00 (TCA)
  pins: WO0 PA0; WO1 PA1 or PC1/TCA0_ALT2; WO2 PC2/TCA0_ALT2; WO3 PC3/TCA0_ALT2; WO4 PD4/TCA0_ALT3; WO5 PD5/TCA0_ALT3
  pin routing set by: PORTMUX.TCAROUTEA.TCA0
TCB{n} at {0xB00+0x10*n} (TCB) (n=0..2)
TCD0 at 0x0B80 (TCD)
  pins: WOC2 PD4/TCD0_ALT4; WOD3 PD5/TCD0_ALT4
  pin routing set by: PORTMUX.TCDROUTEA.TCD0
TWI0 at 0x0900 (TWI)
  pins: SCL_DUAL PC3/I2C0 or PC3/I2C0_ALT3; SDA_DUAL PC2/I2C0 or PC2/I2C0_ALT3; SCL PC3/I2C0_ALT2 or PA1/I2C0_ALT3; SDA PC2/I2C0_ALT2 or PA0/I2C0_ALT3
  pin routing set by: PORTMUX.TWIROUTEA.TWI0
USART0 at 0x0800 (USART)
  pins: RXD PA1 or PD5/USART0_ALT3 or PC2/USART0_ALT4; TXD PA0 or PD4/USART0_ALT3 or PC1/USART0_ALT4; XCK PD6/USART0_ALT3 or PC3/USART0_ALT4; XDIR PD7/USART0_ALT3
  pin routing set by: PORTMUX.USARTROUTEA.USART0
USART1 at 0x0820 (USART)
  pins: RXD PC1 or PD7/USART1_ALT2; XCK PC2; XDIR PC3; TXD PD6/USART1_ALT2
  pin routing set by: PORTMUX.USARTROUTEA.USART1
USERROW at 0x1080
VPORTA at 0x0000 (VPORT)
VPORTC at 0x0008 (VPORT)
VPORTD at 0x000C (VPORT)
VPORTF at 0x0014 (VPORT)
VREF at 0x00B0
WDT at 0x0100
ZCD3 at 0x06D8 (ZCD)
  pins: IN PC2
  pin routing set by: PORTMUX.ZCDROUTEA.ZCD3

## Interrupts
1 NMI (CRCSCAN)
2 VLM (BOD)
3 CFD (CLKCTRL)
4 MVIO
5 CNT (RTC)
6 PIT (RTC)
7 CCL
8 PORT (PORTA)
9 LUNF (TCA0)
9 OVF (TCA0)
10 HUNF (TCA0)
11 CMP0 (TCA0)
11 LCMP0 (TCA0)
12 CMP1 (TCA0)
12 LCMP1 (TCA0)
13 CMP2 (TCA0)
13 LCMP2 (TCA0)
14 INT (TCB0)
15 INT (TCB1)
16 OVF (TCD0)
17 TRIG (TCD0)
18 TWIS (TWI0)
19 TWIM (TWI0)
20 INT (SPI0)
21 RXC (USART0)
22 DRE (USART0)
23 TXC (USART0)
24 PORT (PORTD)
25 AC (AC0)
26 RESRDY (ADC0)
27 WCMP (ADC0)
28 ZCD (ZCD3)
29 PORT (PORTC)
30 INT (TCB2)
31 RXC (USART1)
32 DRE (USART1)
33 TXC (USART1)
34 PORT (PORTF)
35 EE (NVMCTRL)

## Properties
OCD_FEATURES: BREAK_PIN=PF6, BREAK_PIN_ALT=PF2
SIGNATURES: SIGNATURE0=0x1E, SIGNATURE1=0x96, SIGNATURE2=0x1D

## Pinouts (pin number, pad)
SOIC14MVIO: 1 AGND, 2 PF6, 3 PF7, 4 PA0, 5 PA1, 6 PC1, 7 PC2, 8 PC3, 9 VDDIO2, 10 PD4, 11 PD5, 12 PD6, 13 PD7, 14 AVDD
