# AVR64DD32 device description
Architecture: AVR8X; Family: AVR
Programming and debug interfaces: UPDI
Registers are 8-bit, read-write, reset 0x0 unless marked. A register's access mark holds for its fields unless they carry their own. Offsets are from the block's base; lines under a group give offsets from that group; [hi:lo] are bit positions; {n}, {i} and the like mark numbered series; 'fields as' and 'values as' point back to an identical list; <NAME> marks a mode.

## Ordering variants
AVR64DD32: QFN32, pinout QFN32MVIO, up to 32 MHz, -40 to 125 C, 1.8 to 5.5 V

## Memory
data space: start 0x0000 size 0x10000, little endian
  0x00 IO size 0x103F io, rw
  0x1040 LOCKBITS size 0x04 lockbits, rw, page 0x1
  0x1050 FUSES size 0x10 fuses, rw, page 0x1
  0x1080 USER_SIGNATURES size 0x20 user_signatures, rw, page 0x20
  0x1100 SIGNATURES size 0x03 signatures, ro, page 0x80
  0x1103 PROD_SIGNATURES size 0x7D signatures, ro, page 0x80
  0x1400 EEPROM size 0x100 eeprom, rw, page 0x1
  0x6000 INTERNAL_SRAM size 0x2000 ram, rw
  0x8000 MAPPED_PROGMEM size 0x8000 other, rw, page 0x200
prog space: start 0x0000 size 0x10000, little endian
  0x00 PROGMEM size 0x10000 flash, rw, executable, page 0x200

## Peripheral instances (address, pins/pin function, parameters)
AC0 at 0x0680 (AC)
  pins: N0 PD3; N2 PD7; N3 PC2; P0 PD2; P3 PD6; P4 PC3; OUT0 PA7
  pin routing set by: PORTMUX.ACROUTEA.AC0
ADC0 at 0x0600 (ADC)
  pins: AIN1 PD1/AIN0; AIN2 PD2/AIN0; AIN3 PD3/AIN0; AIN4 PD4/AIN0; AIN5 PD5/AIN0; AIN6 PD6/AIN0; AIN7 PD7/AIN0; AIN16 PF0/AIN0; AIN17 PF1/AIN0; AIN18 PF2/AIN0; AIN19 PF3/AIN0; AIN20 PF4/AIN0; AIN21 PF5/AIN0; AIN22 PA2/AIN0; AIN23 PA3/AIN0; AIN24 PA4/AIN0; AIN25 PA5/AIN0; AIN26 PA6/AIN0; AIN27 PA7/AIN0; AIN28 PC0/AIN0; AIN29 PC1/AIN0; AIN30 PC2/AIN0; AIN31 PC3/AIN0
BOD at 0x00A0
CCL at 0x01C0
  pins: LUT0_IN0 PA0 or PA0/CCL_ALT1; LUT0_IN1 PA1 or PA1/CCL_ALT1; LUT0_IN2 PA2 or PA2/CCL_ALT1; LUT0_OUT0 PA3 or PA6/CCL_ALT1; LUT1_IN0 PC0 or PC0/CCL_ALT1; LUT1_IN1 PC1 or PC1/CCL_ALT1; LUT1_IN2 PC2 or PC2/CCL_ALT1; LUT1_OUT0 PC3; LUT2_IN1 PD1 or PD1/CCL_ALT1; LUT2_IN2 PD2 or PD2/CCL_ALT1; LUT2_OUT0 PD3 or PD6/CCL_ALT1; LUT3_IN0 PF0; LUT3_IN1 PF1; LUT3_IN2 PF2; LUT3_OUT0 PF3
  pin routing set by: PORTMUX.CCLROUTEA.LUT0, PORTMUX.CCLROUTEA.LUT1, PORTMUX.CCLROUTEA.LUT2, PORTMUX.CCLROUTEA.LUT3
CLKCTRL at 0x0060
  pins: CLKOUT PA7; EXTCLK PA0; XTAL32K1 PF0 or PA0/CLKCTRL_ALT1; XTAL32K2 PF1 or PA1/CLKCTRL_ALT1; XTALHF1 PA0; XTALHF2 PA1
CPU at 0x0030
  parameters: CORE_VERSION=V4S
CPUINT at 0x0110
CRCSCAN at 0x0120
DAC0 at 0x06A0 (DAC)
  pins: OUT0 PD6
EVSYS at 0x0200
  pins: EVOUT0 PA2 or PA7/EVSYS_ALT1; EVOUT2 PC2; EVOUT3 PD2 or PD7/EVSYS_ALT1; EVOUT5 PF2 or PF7/EVSYS_ALT1
  pin routing set by: PORTMUX.EVSYSROUTEA.EVOUTA, PORTMUX.EVSYSROUTEA.EVOUTC, PORTMUX.EVSYSROUTEA.EVOUTD, PORTMUX.EVSYSROUTEA.EVOUTF
FUSE at 0x1050
GPR at 0x001C
LOCK at 0x1040
MVIO at 0x00C0
NVMCTRL at 0x1000
PORTA at 0x0400 (PORT)
  pins: PIN{n} PA{n}/IOPORT (n=0..7)
PORTC at 0x0440 (PORT)
  pins: PIN0 PC0/IOPORT; PIN1 PC1/IOPORT; PIN2 PC2/IOPORT; PIN3 PC3/IOPORT
PORTD at 0x0460 (PORT)
  pins: PIN1 PD1/IOPORT; PIN2 PD2/IOPORT; PIN3 PD3/IOPORT; PIN4 PD4/IOPORT; PIN5 PD5/IOPORT; PIN6 PD6/IOPORT; PIN7 PD7/IOPORT
PORTF at 0x04A0 (PORT)
  pins: PIN{n} PF{n}/IOPORT (n=0..7)
PORTMUX at 0x05E0
RSTCTRL at 0x0040
  pins: RESET PF6/OTHER
RTC at 0x0140
SIGROW at 0x1100
SLPCTRL at 0x0050
SPI0 at 0x0940 (SPI)
  pins: MISO PA5 or PA1/SPI0_ALT3 or PD5/SPI0_ALT4 or PC1/SPI0_ALT5 or PC2/SPI0_ALT6; MOSI PA4 or PA0/SPI0_ALT3 or PD4/SPI0_ALT4 or PC0/SPI0_ALT5 or PC1/SPI0_ALT6; SCK PA6 or PC0/SPI0_ALT3 or PD6/SPI0_ALT4 or PC2/SPI0_ALT5 or PC3/SPI0_ALT6; SS PA7 or PC1/SPI0_ALT3 or PD7/SPI0_ALT4 or PC3/SPI0_ALT5 or PF7/SPI0_ALT6
  pin routing set by: PORTMUX.SPIROUTEA.SPI0
SYSCFG at 0x0F00
TCA0 at 0x0A00 (TCA)
  pins: WO0 PA0 or PC0/TCA0_ALT2 or PF0/TCA0_ALT5; WO1 PA1 or PC1/TCA0_ALT2 or PD1/TCA0_ALT3 or PF1/TCA0_ALT5; WO2 PA2 or PC2/TCA0_ALT2 or PD2/TCA0_ALT3 or PF2/TCA0_ALT5; WO3 PA3 or PC3/TCA0_ALT2 or PD3/TCA0_ALT3 or PF3/TCA0_ALT5; WO4 PA4 or PD4/TCA0_ALT3 or PF4/TCA0_ALT5; WO5 PA5 or PD5/TCA0_ALT3 or PF5/TCA0_ALT5
  pin routing set by: PORTMUX.TCAROUTEA.TCA0
TCB0 at 0x0B00 (TCB)
  pins: WO0 PA2 or PF4/TCB0_ALT1
  pin routing set by: PORTMUX.TCBROUTEA.TCB0
TCB1 at 0x0B10 (TCB)
  pins: WO0 PA3 or PF5/TCB1_ALT1
  pin routing set by: PORTMUX.TCBROUTEA.TCB1
TCB2 at 0x0B20 (TCB)
  pins: WO0 PC0
  pin routing set by: PORTMUX.TCBROUTEA.TCB2
TCD0 at 0x0B80 (TCD)
  pins: WOA PA4 or PF0/TCD0_ALT2 or PA4/TCD0_ALT4; WOB1 PA5 or PF1/TCD0_ALT2 or PA5/TCD0_ALT4; WOC2 PA6 or PF2/TCD0_ALT2 or PD4/TCD0_ALT4; WOD3 PA7 or PF3/TCD0_ALT2 or PD5/TCD0_ALT4
  pin routing set by: PORTMUX.TCDROUTEA.TCD0
TWI0 at 0x0900 (TWI)
  pins: SCL PA3/I2C0 or PA3/I2C0_ALT1 or PC3/I2C0_ALT2 or PA1/I2C0_ALT3; SCL_DUAL PC3/I2C0 or PC3/I2C0_ALT3; SDA PA2/I2C0 or PA2/I2C0_ALT1 or PC2/I2C0_ALT2 or PA0/I2C0_ALT3; SDA_DUAL PC2/I2C0 or PC2/I2C0_ALT3
  pin routing set by: PORTMUX.TWIROUTEA.TWI0
USART0 at 0x0800 (USART)
  pins: RXD PA1 or PA5/USART0_ALT1 or PA3/USART0_ALT2 or PD5/USART0_ALT3 or PC2/USART0_ALT4; TXD PA0 or PA4/USART0_ALT1 or PA2/USART0_ALT2 or PD4/USART0_ALT3 or PC1/USART0_ALT4; XCK PA2 or PA6/USART0_ALT1 or PD6/USART0_ALT3 or PC3/USART0_ALT4; XDIR PA3 or PA7/USART0_ALT1 or PD7/USART0_ALT3
  pin routing set by: PORTMUX.USARTROUTEA.USART0
USART1 at 0x0820 (USART)
  pins: RXD PC1 or PD7/USART1_ALT2; TXD PC0 or PD6/USART1_ALT2; XCK PC2; XDIR PC3
  pin routing set by: PORTMUX.USARTROUTEA.USART1
USERROW at 0x1080
VPORTA at 0x0000 (VPORT)
VPORTC at 0x0008 (VPORT)
VPORTD at 0x000C (VPORT)
VPORTF at 0x0014 (VPORT)
VREF at 0x00B0
WDT at 0x0100
ZCD3 at 0x06D8 (ZCD)
  pins: IN PC2; OUT PA7
  pin routing set by: PORTMUX.ZCDROUTEA.ZCD3

## Interrupts
1 NMI (CRCSCAN)
2 VLM (BOD)
3 CFD (CLKCTRL)
4 MVIO
5 CNT (RTC)
6 PIT (RTC)
7 CCL
8 PORT (PORTA)
9 LUNF (TCA0)
9 OVF (TCA0)
10 HUNF (TCA0)
11 CMP0 (TCA0)
11 LCMP0 (TCA0)
12 CMP1 (TCA0)
12 LCMP1 (TCA0)
13 CMP2 (TCA0)
13 LCMP2 (TCA0)
14 INT (TCB0)
15 INT (TCB1)
16 OVF (TCD0)
17 TRIG (TCD0)
18 TWIS (TWI0)
19 TWIM (TWI0)
20 INT (SPI0)
21 RXC (USART0)
22 DRE (USART0)
23 TXC (USART0)
24 PORT (PORTD)
25 AC (AC0)
26 RESRDY (ADC0)
27 WCMP (ADC0)
28 ZCD (ZCD3)
29 PORT (PORTC)
30 INT (TCB2)
31 RXC (USART1)
32 DRE (USART1)
33 TXC (USART1)
34 PORT (PORTF)
35 EE (NVMCTRL)

## Properties
OCD_FEATURES: BREAK_PIN=PF6, BREAK_PIN_ALT=PF2
SIGNATURES: SIGNATURE0=0x1E, SIGNATURE1=0x96, SIGNATURE2=0x1A

## Pinouts (pin number, pad)
QFN32MVIO: 1 PA3, 2 PA4, 3 PA5, 4 PA6, 5 PA7, 6 PC0, 7 PC1, 8 PC2, 9 PC3, 10 VDDIO2, 11 PD1, 12 PD2, 13 PD3, 14 PD4, 15 PD5, 16 PD6, 17 PD7, 18 AVDD, 19 AGND, 20 PF0, 21 PF1, 22 PF2, 23 PF3, 24 PF4, 25 PF5, 26 PF6, 27 PF7, 28 VDD0, 29 GND0, 30 PA0, 31 PA1, 32 PA2
